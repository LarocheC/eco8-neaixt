/**
 * ai_dpu_se_stream.c — see ai_dpu_se_stream.h.
 *
 * Targets the ST Edge AI "STAI" runtime API emitted by `stedgeai generate` for the
 * Neural-ART NPU (stai_network_init/run/get_info/get_inputs/get_outputs). Wiring was
 * derived from the real generated stai_network.h for cp_convfsenet/g_best.onnx
 * (10 inputs, 10 outputs) and the verified int8 boundary (see model_io_layout.h).
 *
 * KEY FACTS this code relies on (all verified from the compiled model, B=1):
 *   - get_inputs()/get_outputs() return buffers in ONNX declaration order, so
 *     index 0 = noisy_mag / mask, indices 1..9 = the state tensors, and the
 *     feedback map is simply out[k] -> in[k].
 *   - state_out[k] and state_in[k] share identical int8 scale AND zero-point
 *     (zp = -128), so feeding state back is a RAW BYTE COPY — no requantization.
 *   - noisy_mag is float32 at the boundary (the compiler could not fold its input
 *     QuantizeLinear), so we write floats directly; the model's internal Quantize
 *     epoch (on the M55) handles it.
 *   - the int8 code for float 0.0 at the state boundary is -128, so "zero state"
 *     is memset(0x80), NOT memset(0x00).
 *
 * The buffers live inside the NPU activations arena by default and are NOT
 * relocatable (stai_network_set_inputs would reject a foreign pointer). So we use
 * the get_inputs/get_outputs addresses directly and memcpy state across them. If
 * you later compile with --no-inputs-allocation/--no-outputs-allocation you can
 * alias out[k] and in[k] to the same RAM and drop the memcpy (see README §6).
 *
 * Cache discipline (top cause of garbage NPU output): the M55 D-cache and the NPU
 * share memory, so after the M55 writes an NPU input we clean that range, and
 * before the M55 reads an NPU output we invalidate it. Helpers below are the ones
 * shipped by the GettingStarted-Audio package (Middlewares/.../mcu_cache.c).
 */
#include <string.h>

#include "stai_network.h"      /* generated: stai_* API + STAI_NETWORK_{IN,OUT}_NUM */
#include "model_io_layout.h"   /* generated by host/gen_io_layout.py */
#include "ai_dpu_se_stream.h"

/* Cache maintenance helpers provided by the STM32N6 BSP / audio package.
 * (Middlewares/ST/AI/Npu/Devices/STM32N6xx/mcu_cache.c) */
extern void mcu_cache_clean_range(uint32_t start, uint32_t end);
extern void mcu_cache_clean_invalidate_range(uint32_t start, uint32_t end);

/* Compile-time agreement between the generated model and our layout header. */
_Static_assert(STAI_NETWORK_IN_NUM  == MODEL_N_IO, "input count mismatch");
_Static_assert(STAI_NETWORK_OUT_NUM == MODEL_N_IO, "output count mismatch");
_Static_assert(MODEL_FEATURE_IN_IDX == 0 && MODEL_MASK_OUT_IDX == 0, "feature/mask must be index 0");

/* The NPU network instance (opaque context sized by the generated header). */
static uint8_t s_net_ctx[STAI_NETWORK_CONTEXT_SIZE] __attribute__((aligned(8)));
static stai_network *const s_net = (stai_network *)s_net_ctx;

/* Cached I/O buffer pointers + per-buffer byte sizes (filled at init). */
static stai_ptr s_in[STAI_NETWORK_IN_NUM];
static stai_ptr s_out[STAI_NETWORK_OUT_NUM];
static uint32_t s_in_bytes[STAI_NETWORK_IN_NUM];
static uint32_t s_out_bytes[STAI_NETWORK_OUT_NUM];

/* Per-buffer byte sizes from the generated header (index 0..N-1). */
static const uint32_t k_in_bytes[STAI_NETWORK_IN_NUM] = {
    STAI_NETWORK_IN_1_SIZE_BYTES,  STAI_NETWORK_IN_2_SIZE_BYTES,  STAI_NETWORK_IN_3_SIZE_BYTES,
    STAI_NETWORK_IN_4_SIZE_BYTES,  STAI_NETWORK_IN_5_SIZE_BYTES,  STAI_NETWORK_IN_6_SIZE_BYTES,
    STAI_NETWORK_IN_7_SIZE_BYTES,  STAI_NETWORK_IN_8_SIZE_BYTES,  STAI_NETWORK_IN_9_SIZE_BYTES,
    STAI_NETWORK_IN_10_SIZE_BYTES,
};
static const uint32_t k_out_bytes[STAI_NETWORK_OUT_NUM] = {
    STAI_NETWORK_OUT_1_SIZE_BYTES, STAI_NETWORK_OUT_2_SIZE_BYTES, STAI_NETWORK_OUT_3_SIZE_BYTES,
    STAI_NETWORK_OUT_4_SIZE_BYTES, STAI_NETWORK_OUT_5_SIZE_BYTES, STAI_NETWORK_OUT_6_SIZE_BYTES,
    STAI_NETWORK_OUT_7_SIZE_BYTES, STAI_NETWORK_OUT_8_SIZE_BYTES, STAI_NETWORK_OUT_9_SIZE_BYTES,
    STAI_NETWORK_OUT_10_SIZE_BYTES,
};

static inline uint32_t addr(const void *p) { return (uint32_t)(uintptr_t)p; }

void se_stream_reset_state(void)
{
    /* "Zero" state = int8 code for float 0.0 at the boundary = -128 (0x80). */
    for (int k = MODEL_STATE_FIRST_IDX; k < MODEL_N_IO; ++k) {
        memset(s_in[k], (int)(uint8_t)MODEL_STATE_ZERO_CODE, s_in_bytes[k]);
        mcu_cache_clean_range(addr(s_in[k]), addr(s_in[k]) + s_in_bytes[k]);
    }
}

int se_stream_init(void)
{
    stai_size n;
    stai_return_code rc;

    stai_runtime_init();
    rc = stai_network_init(s_net);
    if (rc != STAI_SUCCESS) return -1;

    n = STAI_NETWORK_IN_NUM;
    rc = stai_network_get_inputs(s_net, s_in, &n);
    if (rc != STAI_SUCCESS || n != STAI_NETWORK_IN_NUM) return -2;

    n = STAI_NETWORK_OUT_NUM;
    rc = stai_network_get_outputs(s_net, s_out, &n);
    if (rc != STAI_SUCCESS || n != STAI_NETWORK_OUT_NUM) return -3;

    memcpy(s_in_bytes, k_in_bytes, sizeof(s_in_bytes));
    memcpy(s_out_bytes, k_out_bytes, sizeof(s_out_bytes));

    se_stream_reset_state();
    return 0;
}

int se_stream_process_frame(const float *mag_in, float *mask_out)
{
    /* 1. Write the float32 magnitude feature into input[0], then clean its cache
     *    line range so the NPU sees fresh data. */
    float *feat = (float *)s_in[MODEL_FEATURE_IN_IDX];
    memcpy(feat, mag_in, MODEL_FEATURE_LEN * sizeof(float));
    mcu_cache_clean_range(addr(feat), addr(feat) + s_in_bytes[MODEL_FEATURE_IN_IDX]);
    /* State inputs were already cleaned at init / end of previous frame. */

    /* 2. Run one synchronous inference (blocks until NPU + SW epochs complete). */
    if (stai_network_run(s_net, STAI_MODE_SYNC) != STAI_SUCCESS) return -1;

    /* 3. Invalidate output ranges before the M55 reads them. */
    for (int k = 0; k < MODEL_N_IO; ++k)
        mcu_cache_clean_invalidate_range(addr(s_out[k]), addr(s_out[k]) + s_out_bytes[k]);

    /* 4. Dequantize the int8 mask: mask_f = (q - zp) * scale, with zp = -128. */
    const int8_t *q = (const int8_t *)s_out[MODEL_MASK_OUT_IDX];
    for (int i = 0; i < MODEL_MASK_LEN; ++i)
        mask_out[i] = (float)((int)q[i] - MODEL_MASK_ZEROPOINT) * MODEL_MASK_SCALE;

    /* 5. Feed recurrent state forward: out[k] -> in[k] as a raw int8 copy
     *    (scale+zp verified identical), then clean the input range for next run. */
    for (int k = MODEL_STATE_FIRST_IDX; k < MODEL_N_IO; ++k) {
        memcpy(s_in[k], s_out[k], s_in_bytes[k]);   /* sizes match by construction */
        mcu_cache_clean_range(addr(s_in[k]), addr(s_in[k]) + s_in_bytes[k]);
    }
    return 0;
}
